/dts-v1/;
#include "demetra_v2_common.dtsi"

/ {
    model = "Demetra v2 Right";
    compatible = "custom,demetra_v2_right";

    kscan0: kscan {
        compatible = "zmk,kscan-gpio-direct";
        label = "KSCAN";

        // Mappatura rigorosa dei 17 pin fisici verso GND (Lato Destro)
        input-gpios
            = <&gpio0 2  (GPIO_ACTIVE_LOW | GPIO_PULL_UP)> // 17: K11
            , <&gpio0 28 (GPIO_ACTIVE_LOW | GPIO_PULL_UP)> // 18: K12
            , <&gpio0 27 (GPIO_ACTIVE_LOW | GPIO_PULL_UP)> // 19: K13
            , <&gpio0 26 (GPIO_ACTIVE_LOW | GPIO_PULL_UP)> // 20: K14
            , <&gpio0 25 (GPIO_ACTIVE_LOW | GPIO_PULL_UP)> // 21: K15
            , <&gpio1 14 (GPIO_ACTIVE_LOW | GPIO_PULL_UP)> // 22: K21
            , <&gpio1 12 (GPIO_ACTIVE_LOW | GPIO_PULL_UP)> // 23: K22
            , <&gpio1 9  (GPIO_ACTIVE_LOW | GPIO_PULL_UP)> // 24: K23
            , <&gpio0 29 (GPIO_ACTIVE_LOW | GPIO_PULL_UP)> // 25: K24
            , <&gpio1 10 (GPIO_ACTIVE_LOW | GPIO_PULL_UP)> // 26: K25
            , <&gpio0 5  (GPIO_ACTIVE_LOW | GPIO_PULL_UP)> // 27: K31
            , <&gpio0 3  (GPIO_ACTIVE_LOW | GPIO_PULL_UP)> // 28: K32
            , <&gpio1 13 (GPIO_ACTIVE_LOW | GPIO_PULL_UP)> // 29: K33
            , <&gpio0 30 (GPIO_ACTIVE_LOW | GPIO_PULL_UP)> // 30: K34
            , <&gpio0 31 (GPIO_ACTIVE_LOW | GPIO_PULL_UP)> // 31: K35
            , <&gpio1 15 (GPIO_ACTIVE_LOW | GPIO_PULL_UP)> // 32: KT1
            , <&gpio0 7  (GPIO_ACTIVE_LOW | GPIO_PULL_UP)> // 33: KT2
            ;
    };
};
