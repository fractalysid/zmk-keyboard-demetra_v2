## boards/fractalysid/demetra_v2/Kconfig.defconfig
```kconfig
# Copyright (c) 2026 Mattia Buscema
# SPDX-License-Identifier: MIT

if BOARD_DEMETRA_V2_LEFT

config ZMK_SPLIT_ROLE_CENTRAL
    default y

endif # BOARD_DEMETRA_V2_LEFT

if BOARD_DEMETRA_V2_LEFT || BOARD_DEMETRA_V2_RIGHT

config ZMK_SPLIT
    default y

config BT_CTLR
    default BT

config PINCTRL
    default y

if USB

config USB_NRFX
    default y

config USB_DEVICE_STACK
    default y

endif # USB

endif # BOARD_DEMETRA_V2_LEFT || BOARD_DEMETRA_V2_RIGHT
```

## boards/fractalysid/demetra_v2/board.yml
```yaml
boards:
  - name: demetra_v2_left
    vendor: fractalysid
    socs:
      - name: nrf52840
  - name: demetra_v2_right
    vendor: fractalysid
    socs:
      - name: nrf52840
```

## boards/fractalysid/demetra_v2/demetra_v2_left_nrf52840_defconfig
```kconfig
# Copyright (c) 2026 Mattia Buscema
# SPDX-License-Identifier: MIT
# NOTA: nome con qualifier (_nrf52840_) per non farsi trovare dal glob
# HWMv1 di Zephyr 3.5, che cerca <board>_defconfig esatto in boards/*/*.

CONFIG_ZMK_KEYBOARD_NAME="Demetra v2"

# USB + BLE
CONFIG_ZMK_USB=y
CONFIG_ZMK_BLE=y
CONFIG_USB_DEVICE_VID=0x1D50
CONFIG_USB_DEVICE_PID=0x615E

# Igiene di build
CONFIG_ARM_MPU=y
CONFIG_GPIO=y

# Linka l'app all'offset di code_partition (0x26000) richiesto dal bootloader Adafruit
CONFIG_USE_DT_CODE_PARTITION=y
CONFIG_BUILD_OUTPUT_UF2=y

# Storage per il bonding Bluetooth
CONFIG_MPU_ALLOW_FLASH_WRITE=y
CONFIG_NVS=y
CONFIG_SETTINGS_NVS=y
CONFIG_FLASH=y
CONFIG_FLASH_PAGE_LAYOUT=y
CONFIG_FLASH_MAP=y

# Oscillatore: RC interno (il BMD-340 non ha LFXO 32kHz)
CONFIG_CLOCK_CONTROL_NRF_K32SRC_RC=y
CONFIG_CLOCK_CONTROL_NRF_K32SRC_500PPM=y
```

## hwm1/boards/arm/demetra_v2/Kconfig
```kconfig
# Copyright (c) 2026 Matt Drake
# SPDX-License-Identifier: MIT

if BOARD_DEMETRA_V2_LEFT || BOARD_DEMETRA_V2_RIGHT

config BOARD_ENABLE_DCDC
    bool "Enable DCDC mode"
    default y
    select SOC_DCDC_NRF52X
	select SOC_DCDC_NRF52X_HV

config DEMETRA_V2_BOOT_MARKER
    bool "Boot marker: traccia il boot col LED su P0.15 (bring-up)"
    default n
    help
      Usa il LED blu (P0.15, attivo basso) come tracer del boot senza debugger:
      lampo lungo 400ms = init EARLY dell'app eseguita (handoff bootloader OK);
      2 lampi brevi = kernel su (POST_KERNEL raggiunto);
      LED fisso acceso = init completata fino a livello APPLICATION.
      Se il LED resta acceso DURANTE i lampi brevi: k_busy_wait bloccata
      → timer di sistema/LFCLK morto. Disattivare a bring-up concluso.

config DEMETRA_V2_STORAGE_NUKE
    bool "Build one-shot: cancella la storage partition (NVS) e si ferma"
    default n
    help
      Firmware usa-e-getta per bring-up: a inizio APPLICATION cancella la
      partizione storage (0xEC000, 32KB) e lampeggia rapido per sempre.
      Serve quando la flash alta contiene residui di staging DFU che
      corrompono gli NVS. Dopo l'uso riflashare il firmware normale.

endif
```

## hwm1/boards/arm/demetra_v2/Kconfig.board
```kconfig
config BOARD_DEMETRA_V2_LEFT
    bool "Demetra v2 Left"
    depends on SOC_NRF52840_QIAA

config BOARD_DEMETRA_V2_RIGHT
    bool "Demetra v2 Right"
    depends on SOC_NRF52840_QIAA
```

## hwm1/boards/arm/demetra_v2/Kconfig.defconfig
```kconfig
# Copyright (c) 2026 Matt Drake (o il tuo nome)
# SPDX-License-Identifier: MIT

if BOARD_DEMETRA_V2_LEFT || BOARD_DEMETRA_V2_RIGHT

config BOARD
    default "demetra_v2"

# Abilita il driver USB specifico per nRF52 se lo stack USB è attivo
if USB_DEVICE_STACK
config USB_NRFX
    default y

config USB_DEVICE_VID
    default 0x1D50

config USB_DEVICE_PID
    default 0x615E
endif # USB_DEVICE_STACK

# Forza il controller Bluetooth nativo
config BT_CTLR
    default y if ZMK_BLE

# Ruolo master solo per il lato sinistro
if BOARD_DEMETRA_V2_LEFT
config ZMK_SPLIT_BLE_ROLE_CENTRAL
    default y
endif

endif # BOARD_DEMETRA_V2_LEFT || BOARD_DEMETRA_V2_RIGHT
```

## hwm1/boards/arm/demetra_v2/demetra_v2_left_defconfig
```kconfig
CONFIG_SOC_SERIES_NRF52X=y
CONFIG_SOC_NRF52840_QIAA=y
CONFIG_BOARD_DEMETRA_V2_LEFT=y

# Linka l'app all'offset di code_partition (0x26000) richiesto dal bootloader Adafruit.
# Senza questo l'app viene linkata a 0x0 (FLASH_LOAD_OFFSET=0) e non si avvia.
CONFIG_USE_DT_CODE_PARTITION=y

# Igiene di build
CONFIG_ARM_MPU=y
CONFIG_PINCTRL=y
CONFIG_GPIO=y

# Storage per il bonding Bluetooth (i pairing persistono al reboot)
CONFIG_MPU_ALLOW_FLASH_WRITE=y
CONFIG_NVS=y
CONFIG_SETTINGS_NVS=y
CONFIG_FLASH=y
CONFIG_FLASH_PAGE_LAYOUT=y
CONFIG_FLASH_MAP=y

# Alimentazione: DCDC OFF per TEST (verifichiamo se senza induttore il BMD-340 va in brownout)
CONFIG_BOARD_ENABLE_DCDC=n

# Oscillatore
CONFIG_CLOCK_CONTROL_NRF_K32SRC_RC=y
CONFIG_CLOCK_CONTROL_NRF_K32SRC_500PPM=y

# Architettura ZMK
CONFIG_ZMK_SPLIT=y
CONFIG_USB_DEVICE_STACK=y

# GENERAZIONE UF2 (Questa è la variabile nativa di Zephyr che produce il file)
CONFIG_BUILD_OUTPUT_UF2=y
```

## hwm1/boards/arm/demetra_v2/demetra_v2_right_defconfig
```kconfig
CONFIG_SOC_SERIES_NRF52X=y
CONFIG_SOC_NRF52840_QIAA=y
CONFIG_BOARD_DEMETRA_V2_RIGHT=y

# Linka l'app all'offset di code_partition (0x26000) richiesto dal bootloader Adafruit.
# Senza questo l'app viene linkata a 0x0 (FLASH_LOAD_OFFSET=0) e non si avvia.
CONFIG_USE_DT_CODE_PARTITION=y

# Igiene di build
CONFIG_ARM_MPU=y
CONFIG_PINCTRL=y
CONFIG_GPIO=y

# Storage per il bonding Bluetooth (i pairing persistono al reboot)
CONFIG_MPU_ALLOW_FLASH_WRITE=y
CONFIG_NVS=y
CONFIG_SETTINGS_NVS=y
CONFIG_FLASH=y
CONFIG_FLASH_PAGE_LAYOUT=y
CONFIG_FLASH_MAP=y

# Alimentazione: DCDC attivo (default y dal Kconfig della board; induttori
# integrati nel BMD-340). Era =n solo per i test di bring-up.

CONFIG_CLOCK_CONTROL_NRF_K32SRC_RC=y
CONFIG_CLOCK_CONTROL_NRF_K32SRC_500PPM=y

CONFIG_ZMK_SPLIT=y

# GENERAZIONE UF2
CONFIG_BUILD_OUTPUT_UF2=y
```
