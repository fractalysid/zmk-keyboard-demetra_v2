/dts-v1/;
#include "demetra_v2_common.dtsi"

/ {
    model = "Demetra v2 Right";
    compatible = "custom,demetra_v2_right";

    kscan0: kscan {
        compatible = "zmk,kscan-gpio-direct";
        label = "KSCAN";

        // Mappatura rigorosa dei 17 pin fisici verso GND (Lato Destro)
        // PCB specchiata: le net Kxy corrono dall'interno verso l'esterno,
        // quindi ogni riga va elencata al contrario (K15→K11) e i pollici
        // scambiati, così la colonna del transform segue l'ordine fisico
        // sinistra→destra atteso dal keymap. Verificato sul campo 2026-06-12.
        input-gpios
            = <&gpio0 25 (GPIO_ACTIVE_LOW | GPIO_PULL_UP)> // 17: K15
            , <&gpio0 26 (GPIO_ACTIVE_LOW | GPIO_PULL_UP)> // 18: K14
            , <&gpio0 27 (GPIO_ACTIVE_LOW | GPIO_PULL_UP)> // 19: K13
            , <&gpio0 28 (GPIO_ACTIVE_LOW | GPIO_PULL_UP)> // 20: K12
            , <&gpio0 2  (GPIO_ACTIVE_LOW | GPIO_PULL_UP)> // 21: K11
            , <&gpio1 10 (GPIO_ACTIVE_LOW | GPIO_PULL_UP)> // 22: K25
            , <&gpio0 29 (GPIO_ACTIVE_LOW | GPIO_PULL_UP)> // 23: K24
            , <&gpio1 9  (GPIO_ACTIVE_LOW | GPIO_PULL_UP)> // 24: K23
            , <&gpio1 12 (GPIO_ACTIVE_LOW | GPIO_PULL_UP)> // 25: K22
            , <&gpio1 14 (GPIO_ACTIVE_LOW | GPIO_PULL_UP)> // 26: K21
            , <&gpio0 31 (GPIO_ACTIVE_LOW | GPIO_PULL_UP)> // 27: K35
            , <&gpio0 30 (GPIO_ACTIVE_LOW | GPIO_PULL_UP)> // 28: K34
            , <&gpio1 13 (GPIO_ACTIVE_LOW | GPIO_PULL_UP)> // 29: K33
            , <&gpio0 3  (GPIO_ACTIVE_LOW | GPIO_PULL_UP)> // 30: K32
            , <&gpio0 5  (GPIO_ACTIVE_LOW | GPIO_PULL_UP)> // 31: K31
            , <&gpio0 7  (GPIO_ACTIVE_LOW | GPIO_PULL_UP)> // 32: KT2
            , <&gpio1 15 (GPIO_ACTIVE_LOW | GPIO_PULL_UP)> // 33: KT1
            ;
    };
};

/* La metà destra riporta le posizioni kscan 0-16: senza questo offset si
   sovrappongono alle colonne 0-16 del left invece di mappare le 17-33. */
&default_transform {
    col-offset = <17>;
};
